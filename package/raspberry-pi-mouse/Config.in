## package/raspberry-pi-mouse/Config.in
```kconfig
config BR2_PACKAGE_RASPBERRY_PI_MOUSE
	bool "raspberry-pi-mouse"
	help
	  build and install RaspberryPiMouse driver, rtmouse.ko.

	  https://github.com/rt-net/RaspberryPiMouse
```
